## components/radar/Kconfig
```kconfig
menu "Radar Configuration"

    choice RADAR_TYPE
        prompt "Select radar type"
        default RADAR_LD2460

        config RADAR_NMEA
            bool "NMEA Radar (GPS style)"
            help
                NMEA protocol radar, e.g. GPS receivers.
                Uses text-based protocol with line delimiters.

        config RADAR_LD2460
            bool "HLK-LD2460 (2T4R Multi-target Tracking)"
            help
                Hi-Link LD2460 24GHz millimeter wave radar.
                Binary protocol, default baud rate 115200.

    endchoice

    config RADAR_UART_NUM
        int "UART port number"
        default 1
        range 0 2

    config RADAR_UART_TX_PIN
        int "UART TX pin"
        default 1

    config RADAR_UART_RX_PIN
        int "UART RX pin"
        default 2

    config RADAR_UART_BAUD_RATE
        int "UART baud rate (0 = use radar default)"
        default 0

    config RADAR_TASK_STACK_SIZE
        int "Radar parser task stack size"
        default 4096

    config RADAR_TASK_PRIORITY
        int "Radar parser task priority"
        default 10

endmenu
```

## main/Kconfig.projbuild
```kconfig
# HTTP/WebSocket Server Configuration
# 工业级重构配置参数

menu "HTTP/WebSocket Server"

    config HTTP_SERVER_ENABLED
        bool "Enable HTTP Server"
        default y
        help
            Enable the embedded HTTP server for web interface access.

    config HTTP_SERVER_PORT
        int "HTTP Server Port"
        default 80
        range 1 65535
        depends on HTTP_SERVER_ENABLED
        help
            TCP port number for HTTP server to listen on.

    config HTTP_SERVER_STACK_SIZE
        int "HTTP Server Task Stack Size (bytes)"
        default 12288
        range 4096 32768
        depends on HTTP_SERVER_ENABLED
        help
            Stack size for HTTP server task. 12288 is recommended minimum.

    config HTTP_SERVER_MAX_URI_HANDLERS
        int "Maximum URI Handlers"
        default 64
        range 8 64
        depends on HTTP_SERVER_ENABLED
        help
            Maximum number of URI handlers that can be registered.

    config HTTP_SERVER_MAX_OPEN_SOCKETS
        int "Maximum Open Sockets"
        default 7
        range 1 16
        depends on HTTP_SERVER_ENABLED
        help
            Maximum number of simultaneous HTTP connections.

    config HTTP_RECV_TIMEOUT
        int "HTTP Receive Timeout (seconds)"
        default 30
        range 1 60
        depends on HTTP_SERVER_ENABLED
        help
            Timeout for receiving HTTP request data.

    config HTTP_SEND_TIMEOUT
        int "HTTP Send Timeout (seconds)"
        default 30
        range 1 60
        depends on HTTP_SERVER_ENABLED
        help
            Timeout for sending HTTP response data.

    config MAX_UPLOAD_SIZE
        int "Maximum Upload File Size (KB)"
        default 100
        range 10 1024
        depends on HTTP_SERVER_ENABLED
        help
            Maximum file upload size in kilobytes.

endmenu

menu "WebSocket Configuration"
    visible if HTTP_SERVER_ENABLED

    config WS_SERVER_ENABLED
        bool "Enable WebSocket Server"
        default y
        help
            Enable WebSocket support for real-time radar data streaming.

    config WS_MAX_CLIENTS
        int "Maximum WebSocket Clients"
        default 4
        range 1 8
        depends on WS_SERVER_ENABLED
        help
            Maximum number of simultaneous WebSocket clients.

    config WS_HEARTBEAT_INTERVAL
        int "Heartbeat Check Interval (seconds)"
        default 30
        range 10 120
        depends on WS_SERVER_ENABLED
        help
            Interval between client heartbeat/liveness checks.

    config WS_CLIENT_TIMEOUT
        int "Client Timeout (seconds)"
        default 60
        range 30 300
        depends on WS_SERVER_ENABLED
        help
            Time after which an inactive client is disconnected.

    config WS_MSG_QUEUE_SIZE
        int "Message Queue Size Per Client"
        default 10
        range 5 50
        depends on WS_SERVER_ENABLED
        help
            Number of messages that can be queued per client for sending.

    config WS_MAX_MSG_SIZE
        int "Maximum Message Size (bytes)"
        default 2048
        range 512 8192
        depends on WS_SERVER_ENABLED
        help
            Maximum size of a single WebSocket message.

    config WS_TASK_STACK_SIZE
        int "WebSocket Task Stack Size (bytes)"
        default 4096
        range 2048 8192
        depends on WS_SERVER_ENABLED
        help
            Stack size for WebSocket internal tasks.

endmenu

menu "Security Configuration"

    config RATE_LIMIT_ENABLED
        bool "Enable Rate Limiting"
        default y
        help
            Enable per-IP request rate limiting to prevent DoS attacks.

    config RATE_LIMIT_MAX_REQUESTS
        int "Max Requests Per Second"
        default 20
        range 5 100
        depends on RATE_LIMIT_ENABLED
        help
            Maximum requests allowed per IP per second.

    config RATE_LIMIT_WINDOW_MS
        int "Rate Limit Window (milliseconds)"
        default 1000
        range 500 5000
        depends on RATE_LIMIT_ENABLED
        help
            Time window for rate limiting in milliseconds.

    config RATE_LIMIT_BLOCK_DURATION
        int "Block Duration (seconds)"
        default 5
        range 1 60
        depends on RATE_LIMIT_ENABLED
        help
            Duration to block an IP that exceeds the rate limit.

    config RATE_LIMIT_MAX_ENTRIES
        int "Max Rate Limit Entries"
        default 32
        range 8 128
        depends on RATE_LIMIT_ENABLED
        help
            Maximum number of IP addresses to track for rate limiting.

    config CORS_ENABLED
        bool "Enable CORS"
        default n
        help
            Enable Cross-Origin Resource Sharing.

    config CORS_ORIGIN
        string "CORS Allowed Origin"
        default "*"
        depends on CORS_ENABLED
        help
            Allowed origin for CORS. Use "*" for any origin, or specify a domain.

    config SECURITY_HEADERS_ENABLED
        bool "Enable Security Headers"
        default y
        help
            Add security headers (X-Content-Type-Options, X-Frame-Options, etc.) to responses.

    config X_CONTENT_TYPE_OPTIONS
        bool "X-Content-Type-Options: nosniff"
        default y
        depends on SECURITY_HEADERS_ENABLED
        help
            Prevent MIME type sniffing.

    config X_FRAME_OPTIONS
        bool "X-Frame-Options: DENY"
        default y
        depends on SECURITY_HEADERS_ENABLED
        help
            Prevent clickjacking by disabling iframe embedding.

    config CONTENT_SECURITY_POLICY
        bool "Enable Content-Security-Policy"
        default n
        depends on SECURITY_HEADERS_ENABLED
        help
            Enable CSP header. Recommended for production.

endmenu

menu "Broadcast Configuration"
    visible if WS_SERVER_ENABLED

    config RADAR_BROADCAST_ENABLED
        bool "Enable Radar Data Broadcast"
        default y
        help
            Broadcast radar detection data to WebSocket clients.

    config RADAR_BROADCAST_INTERVAL
        int "Broadcast Interval (milliseconds)"
        default 100
        range 50 1000
        depends on RADAR_BROADCAST_ENABLED
        help
            Interval between radar data broadcasts in milliseconds. 100ms = 10Hz.

    config RADAR_BROADCAST_TASK_STACK
        int "Broadcast Task Stack Size (bytes)"
        default 4096
        range 2048 8192
        depends on RADAR_BROADCAST_ENABLED
        help
            Stack size for radar broadcast task.

endmenu

menu "File System Configuration"

    config FATFS_MOUNT_PATH
        string "FATFS Mount Path"
        default "/storage"
        help
            Mount path for FATFS partition.

    config STATIC_FILE_ROOT
        string "Static Files Root Directory"
        default "/www"
        help
            Directory under mount path where static files are served from.

endmenu
```

## sdkconfig.defaults
```kconfig
# LD Radar Web Monitor - 默认配置
# ESP32-C3 默认配置

# 目标芯片
CONFIG_IDF_TARGET="esp32c3"

# Flash 大小
CONFIG_ESPTOOLPY_FLASHSIZE_4MB=y
CONFIG_ESPTOOLPY_FLASHSIZE="4MB"

# 分区表
CONFIG_PARTITION_TABLE_CUSTOM=y
CONFIG_PARTITION_TABLE_CUSTOM_FILENAME="partitions.csv"
CONFIG_PARTITION_TABLE_FILENAME="partitions.csv"

# FATFS 配置
CONFIG_FATFS_LFN_HEAP=y
CONFIG_FATFS_MAX_LFN=255
CONFIG_FATFS_API_ENCODING_UTF_8=y

# HTTP Server 配置
CONFIG_HTTPD_MAX_REQ_HDR_LEN=2048
CONFIG_HTTPD_MAX_URI_LEN=512
CONFIG_HTTPD_ERR_RESP_NO_DELAY=y
CONFIG_HTTPD_PURGE_BUF_LEN=128
CONFIG_HTTPD_WS_SUPPORT=y
CONFIG_HTTP_SERVER_MAX_URI_HANDLERS=64

# LWIP 配置 - 增加 socket 数量和 TCP 缓冲区（减少帧碎片）
CONFIG_LWIP_MAX_SOCKETS=24
CONFIG_LWIP_TCP_SND_BUF_DEFAULT=8192
CONFIG_LWIP_TCP_WND_DEFAULT=8192
CONFIG_LWIP_TCP_RCV_WND_DEFAULT=8192
CONFIG_LWIP_TCP_MSS=1460

# WiFi 配置
CONFIG_ESP_WIFI_AUTH_WPA_PSK=y
CONFIG_ESP_WIFI_AUTH_WPA2_PSK=y

# 系统配置
CONFIG_ESP_MAIN_TASK_STACK_SIZE=8192
CONFIG_ESP_SYSTEM_EVENT_TASK_STACK_SIZE=2048

# 日志级别
CONFIG_LOG_DEFAULT_LEVEL_INFO=y
CONFIG_LOG_MAXIMUM_LEVEL=3

# 日志颜色（串口输出带 ANSI 颜色）
CONFIG_LOG_COLORS=y

# 组件配置
CONFIG_FREERTOS_HZ=100
CONFIG_FREERTOS_TIMER_TASK_STACK_DEPTH=2048

# 看门狗 - 工业级配置
CONFIG_ESP_TASK_WDT=y
CONFIG_ESP_TASK_WDT_TIMEOUT_S=30

# 禁用 TWDT 自动监控 Idle Tasks，只监控显式订阅的任务
# 避免 tiT (TCP/IP) 等 ESP-IDF 内部任务触发 TWDT
CONFIG_ESP_TASK_WDT_CHECK_IDLE_TASK_CPU0=n

# FreeRTOS 栈溢出检测（方法2：最全面，检查每个上下文切换）
CONFIG_FREERTOS_CHECK_STACKOVERFLOW=2

# 雷达配置 - LD2452
CONFIG_RADAR_LD2460=n
CONFIG_RADAR_LD2450=n
CONFIG_RADAR_LD6004=n
CONFIG_RADAR_LD6002B=n
CONFIG_RADAR_LD2461=n
CONFIG_RADAR_LD2452=y
CONFIG_RADAR_R60ABD1=n

# 禁用不需要的功能以节省内存
CONFIG_MBEDTLS_HARDWARE_MPI=n
CONFIG_MBEDTLS_HARDWARE_SHA=n
```
